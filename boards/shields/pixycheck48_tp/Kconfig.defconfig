## boards/shields/pixycheck48_tp/Kconfig.defconfig
```kconfig
if SHIELD_PIXYCHECK48_TP

config ZMK_KEYBOARD_NAME
    default "pixycheck48_tp"

endif # SHIELD_PIXYCHECK48_TP
```

## boards/shields/pixycheck48_tp/Kconfig.shield
```kconfig
config SHIELD_PIXYCHECK48_TP
    def_bool $(shields_list_contains,pixycheck48_tp)
```

## boards/shields/pixycheck48tact/Kconfig.shield
```kconfig
config SHIELD_PIXYCHECK48TACT
    def_bool $(shields_list_contains,pixycheck48tact)
```
